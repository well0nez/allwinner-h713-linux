## analyse/boot/arbeit/g1-uboot/kopie/configs/hy310_qz713_v3_1_defconfig
```kconfig
CONFIG_ARM=y
CONFIG_ARCH_SUNXI=y
CONFIG_DEFAULT_DEVICE_TREE="allwinner/sun50i-h713-hy200-qz713df-a1"
CONFIG_DRAM_CLK=792
CONFIG_SPL=y
# HY200 QZ713DF_A1 (bench): DDR3 (type 3) stock BT0, clk=624.
CONFIG_DRAM_SUNXI_DX_ODT=0x03030303
CONFIG_DRAM_SUNXI_DX_DRI=0x0e0e0e0e
CONFIG_DRAM_SUNXI_CA_DRI=0x1c12
CONFIG_DRAM_SUNXI_ODT_EN=0x1
CONFIG_DRAM_SUNXI_ZQ=0x007b7bfb
CONFIG_DRAM_SUNXI_PARA1=0x000010f4
CONFIG_DRAM_SUNXI_PARA2=0x04000000
CONFIG_DRAM_SUNXI_MR0=0x00001c70
CONFIG_DRAM_SUNXI_MR1=0x00000040
CONFIG_DRAM_SUNXI_MR2=0x00000018
CONFIG_DRAM_SUNXI_MR3=0x00000000
CONFIG_DRAM_SUNXI_TPR0=0x00482151
CONFIG_DRAM_SUNXI_TPR1=0x01b1a94c
CONFIG_DRAM_SUNXI_TPR2=0x0006e04d
CONFIG_DRAM_SUNXI_TPR3=0xb4787896
CONFIG_DRAM_SUNXI_TPR4=0x00000000
CONFIG_DRAM_SUNXI_TPR5=0x48484848
CONFIG_DRAM_SUNXI_TPR6=0x00000048
CONFIG_DRAM_SUNXI_TPR7=0x1620121e
CONFIG_DRAM_SUNXI_TPR8=0x00000000
CONFIG_DRAM_SUNXI_TPR9=0x00000000
CONFIG_DRAM_SUNXI_TPR10=0x00000000
CONFIG_DRAM_SUNXI_TPR11=0x44340000
CONFIG_DRAM_SUNXI_TPR12=0x00006666
CONFIG_DRAM_SUNXI_TPR13=0xb4016103
CONFIG_MACH_SUN50I_H713=y
CONFIG_H713_POWERON_LIGHT_FAN=y
CONFIG_H713_POWER_GATE=y
CONFIG_H713_MIPS_BOOT=y
CONFIG_SUNXI_DRAM_H713_DDR3_STOCK=y
CONFIG_MMC_SUNXI_SLOT_EXTRA=2
CONFIG_MMC0_CD_PIN=""
# CONFIG_SYS_MALLOC_CLEAR_ON_INIT is not set
CONFIG_SUPPORT_EMMC_BOOT=y
CONFIG_USB_EHCI_HCD=y
CONFIG_USB_OHCI_HCD=y
# CONFIG_WATCHDOG is not set
CONFIG_WDT=y
CONFIG_USB_MUSB_GADGET=y
CONFIG_CMD_USB_MASS_STORAGE=y
# CONFIG_USB_ETHER is not set
CONFIG_CONSOLE_MUX=y
CONFIG_SYS_CONSOLE_IS_IN_ENV=y
CONFIG_USB_FUNCTION_ACM=y
# CONFIG_USB_FUNCTION_ACM_WAIT_FOR_CONNECTION is not set
CONFIG_SYSRESET=y
CONFIG_SYSRESET_PSCI=y
CONFIG_CMD_POWEROFF=y
CONFIG_FASTBOOT_CMD_OEM_POWEROFF=y
CONFIG_PREBOOT="if itest.l *0x0709011c == 0xfa57b007; then mw.l 0x0709011c 0; run fastboot_mode; elif itest.l *0x0709011c == 0xb007c0de; then mw.l 0x0709011c 0; setenv bootdelay -1; fi; usb start"
# CONFIG_ENV_IS_IN_FAT is not set
CONFIG_ENV_IS_IN_MMC=y
CONFIG_ENV_OFFSET=0x93d80000
CONFIG_SYS_MMCSD_RAW_MODE_U_BOOT_SECTOR=0x49ac00
CONFIG_SYS_MMCSD_RAW_MODE_U_BOOT_DATA_PART_OFFSET=0x0
CONFIG_H713_VENDOR_CHAINLOAD=y
CONFIG_CMD_WDT=y
CONFIG_CMD_GPIO=y
```
