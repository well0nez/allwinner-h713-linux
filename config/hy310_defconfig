## config/hy310_defconfig
```kconfig
CONFIG_NO_HZ_IDLE=y
CONFIG_HIGH_RES_TIMERS=y
CONFIG_CGROUPS=y
CONFIG_BLK_DEV_INITRD=y
CONFIG_PERF_EVENTS=y
CONFIG_SMP=y
CONFIG_SCHED_SMT=y
CONFIG_CPU_FREQ=y
CONFIG_CPUFREQ_DT=y
CONFIG_CPU_IDLE=y
CONFIG_MODULES=y
CONFIG_MODULE_UNLOAD=y
CONFIG_CMA=y
CONFIG_NET=y
CONFIG_PACKET=y
CONFIG_UNIX=y
CONFIG_INET=y
CONFIG_IP_PNP=y
CONFIG_IP_PNP_DHCP=y
CONFIG_IP_PNP_BOOTP=y
# CONFIG_INET_DIAG is not set
CONFIG_CAN=y
CONFIG_BT=y
CONFIG_BT_HCIUART=m
CONFIG_CFG80211=y
CONFIG_MAC80211=y
CONFIG_RFKILL=y
CONFIG_DEVTMPFS=y
CONFIG_DEVTMPFS_MOUNT=y
CONFIG_HY310_BOARD_MGR=y
CONFIG_HY310_KEYSTONE_MOTOR=y
CONFIG_BLK_DEV_SD=y
CONFIG_ATA=y
CONFIG_NETDEVICES=y
# CONFIG_NET_VENDOR_ARC is not set
# CONFIG_NET_VENDOR_BROADCOM is not set
# CONFIG_NET_VENDOR_INTEL is not set
# CONFIG_NET_VENDOR_MARVELL is not set
# CONFIG_NET_VENDOR_MICREL is not set
# CONFIG_NET_VENDOR_MICROCHIP is not set
# CONFIG_NET_VENDOR_NATSEMI is not set
# CONFIG_NET_VENDOR_SAMSUNG is not set
# CONFIG_NET_VENDOR_SEEQ is not set
CONFIG_STMMAC_ETH=y
# CONFIG_NET_VENDOR_VIA is not set
# CONFIG_NET_VENDOR_WIZNET is not set
CONFIG_MICREL_PHY=y
CONFIG_REALTEK_PHY=y
CONFIG_USB_RTL8152=m
CONFIG_USB_USBNET=m
CONFIG_USB_NET_SMSC95XX=m
CONFIG_USB_NET_RNDIS_HOST=m
CONFIG_RTL8XXXU=m
CONFIG_RTL8XXXU_UNTESTED=y
CONFIG_INPUT_EVDEV=y
CONFIG_KEYBOARD_ADC=m
# CONFIG_INPUT_MOUSE is not set
CONFIG_INPUT_TOUCHSCREEN=y
CONFIG_INPUT_MISC=y
CONFIG_INPUT_AXP20X_PEK=y
CONFIG_SERIAL_8250=y
CONFIG_SERIAL_8250_CONSOLE=y
CONFIG_SERIAL_8250_NR_UARTS=8
CONFIG_SERIAL_8250_RUNTIME_UARTS=8
CONFIG_SERIAL_8250_DW=y
CONFIG_SERIAL_OF_PLATFORM=y
# CONFIG_HW_RANDOM is not set
CONFIG_I2C_CHARDEV=y
CONFIG_SPI=y
CONFIG_PINCTRL=y
CONFIG_GPIOLIB=y
CONFIG_POWER_SUPPLY=y
CONFIG_CHARGER_AXP20X=y
CONFIG_BATTERY_AXP20X=y
CONFIG_AXP20X_POWER=y
CONFIG_THERMAL=y
CONFIG_THERMAL_NETLINK=y
CONFIG_CPU_THERMAL=y
CONFIG_WATCHDOG=y
CONFIG_WATCHDOG_CORE=y
CONFIG_MFD_AXP20X_I2C=y
CONFIG_REGULATOR=y
CONFIG_REGULATOR_FIXED_VOLTAGE=y
CONFIG_REGULATOR_AXP20X=y
CONFIG_REGULATOR_GPIO=y
CONFIG_RC_CORE=y
CONFIG_RC_DEVICES=y
CONFIG_MEDIA_SUPPORT=y
CONFIG_MEDIA_PLATFORM_SUPPORT=y
CONFIG_V4L_PLATFORM_DRIVERS=y
CONFIG_V4L_MEM2MEM_DRIVERS=y
CONFIG_DRM=y
CONFIG_DRM_PANEL_LVDS=y
CONFIG_DRM_PANEL_EDP=y
CONFIG_DRM_PANEL_SIMPLE=y
CONFIG_DRM_SIMPLE_BRIDGE=y
CONFIG_FB=y
CONFIG_FB_VIRTUAL=y
CONFIG_BACKLIGHT_CLASS_DEVICE=y
CONFIG_BACKLIGHT_PWM=y
CONFIG_SOUND=y
CONFIG_SND=y
CONFIG_SND_SOC=y
CONFIG_USB=y
CONFIG_USB_EHCI_HCD=y
CONFIG_USB_EHCI_HCD_PLATFORM=y
CONFIG_USB_OHCI_HCD=y
CONFIG_USB_OHCI_HCD_PLATFORM=y
CONFIG_USB_STORAGE=y
CONFIG_USB_MUSB_HDRC=y
CONFIG_NOP_USB_XCEIV=y
CONFIG_USB_GADGET=y
CONFIG_MMC=y
CONFIG_NEW_LEDS=y
CONFIG_LEDS_CLASS=y
CONFIG_LEDS_GPIO=y
CONFIG_LEDS_TRIGGERS=y
CONFIG_LEDS_TRIGGER_HEARTBEAT=y
CONFIG_LEDS_TRIGGER_DEFAULT_ON=y
CONFIG_RTC_CLASS=y
# CONFIG_RTC_INTF_SYSFS is not set
# CONFIG_RTC_INTF_PROC is not set
CONFIG_DMADEVICES=y
CONFIG_STAGING=y
CONFIG_STAGING_MEDIA=y
CONFIG_HWSPINLOCK=y
CONFIG_MAILBOX=y
CONFIG_HY310_CPU_COMM=m
CONFIG_PM_DEVFREQ=y
CONFIG_DEVFREQ_GOV_SIMPLE_ONDEMAND=y
CONFIG_IIO=y
CONFIG_AXP20X_ADC=y
CONFIG_PWM=y
CONFIG_GENERIC_PHY=y
CONFIG_EXT4_FS=y
CONFIG_VFAT_FS=y
CONFIG_TMPFS=y
CONFIG_NFS_FS=y
CONFIG_NFS_V3_ACL=y
CONFIG_NFS_V4=y
CONFIG_ROOT_NFS=y
CONFIG_NLS_CODEPAGE_437=y
CONFIG_NLS_ISO8859_1=y
CONFIG_CRYPTO_DES=y
CONFIG_CRYPTO_CBC=y
CONFIG_DMA_CMA=y
CONFIG_PRINTK_TIME=y
CONFIG_DYNAMIC_DEBUG=y
CONFIG_DEBUG_FS=y
```

## drivers/Archived/cpu_comm/Kconfig
```kconfig
config HY310_CPU_COMM
	tristate "HY310 CPU_COMM — ARM/MIPS IPC Framework"
	depends on OF
	help
	  Inter-processor communication framework for the HY310 projector.
	  Enables ARM ↔ MIPS display co-processor communication via shared
	  memory and hardware mailbox. Required for display output control.

	  Based on reverse engineering of Allwinner HAL_SX6 cpu_comm framework
	  from the stock H713 firmware.

	  If unsure, say Y.
```

## drivers/Archived/decd/Kconfig
```kconfig
config SUNXI_DECD
	tristate "Allwinner H713 Display Engine Controller (decd)"
	depends on OF && ARCH_SUNXI
	select RESET_CONTROLLER
	help
	  Display engine controller driver for the Allwinner H713 SoC.

	  Provides frame submission, VSync-driven scheduling, DMA-BUF
	  import/export, and dma-fence synchronization for the AFBD
	  (ARM Frame Buffer Decoder) display path.

	  Required for video output on the HY310 projector platform.
	  Depends on sunxi_tvtop for shared display-top resource management.

	  Based on reverse engineering of stock decd.ko from H713 SDK.

	  If unsure, say M.
```

## drivers/Archived/tvtop/Kconfig
```kconfig
config SUNXI_TVTOP
	tristate "Allwinner H713 TV Subsystem Top Module"
	depends on OF && ARCH_SUNXI
	select RESET_CONTROLLER
	help
	  Clock gating, reset control and power domain management for the
	  Allwinner H713 TV subsystem (tvdisp, tvcap, tvfe blocks).

	  Required for display output on the HY310 projector. Manages
	  clocks and power for the display engine, TV capture (HDMI input),
	  and TV front-end (demodulator) subsystems.

	  Based on reverse engineering of stock sunxi_tvtop.ko from
	  H713 SDK V1.3 firmware.

	  If unsure, say Y.
```

## drivers/audio/Kconfig
```kconfig
config SND_SOC_SUNXI_H713_CODEC
	tristate "Allwinner H713 Internal Audio Codec"
	depends on SND_SOC && ARCH_SUNXI && REGMAP_MMIO
	help
	  Enable support for the internal audio codec found in the
	  Allwinner H713 (sun50iw12) SoC. This codec provides stereo
	  DAC output with speaker PA control and stereo ADC input with
	  line-in PGA. Used on the HY310 projector platform.

	  This driver was reverse-engineered from the stock kernel using
	  IDA Pro and verified register-by-register.

	  Say Y or M if you have an Allwinner H713-based device.

config SND_SOC_SUNXI_H713_MACHINE
	tristate "Allwinner H713 Audio Machine Driver"
	depends on SND_SOC
	select SND_SOC_SUNXI_H713_CODEC
	select SND_SOC_SUNXI_H713_CPUDAI
	help
	  Enable the ASoC machine driver that connects the H713 internal
	  audio codec to the CPU-DAI. Creates the ALSA sound card with
	  speaker PA control and clock management per sample rate.

	  Say Y or M if you have an Allwinner H713-based device.

config SND_SOC_SUNXI_H713_CPUDAI
	tristate "Allwinner H713 CPU-DAI / DMA Platform"
	depends on SND_SOC && ARCH_SUNXI
	select SND_SOC_GENERIC_DMAENGINE_PCM
	help
	  Enable the CPU-DAI and DMA platform driver for the Allwinner H713.
	  This provides the PCM data path (DMA channel 7) between ALSA and
	  the internal codec FIFOs at 0x02030020 (DAC TX) and 0x02030040
	  (ADC RX). Uses the kernel's generic dmaengine PCM framework.

	  Say Y or M if you have an Allwinner H713-based device.
```

## drivers/audio/bridge/Kconfig
```kconfig
config SND_HY310_TRID_AUDIO_BRIDGE
	tristate "HY310 Trident audio bridge"
	depends on SOUND && SND && OF && ARCH_SUNXI
	select DMA_SHARED_BUFFER
	help
	  Raw ALSA audio-bridge driver for the HY310 projector on Allwinner H713.
	  This is a port of the stock snd_alsa_trid module used for speaker,
	  bridge, delayline and S/PDIF routing.

	  The implementation is reverse-engineered from stock snd_alsa_trid.ko
	  with IDA Pro and adapted for Linux 6.16 without vendor ION APIs.

	  Say Y or M if you have an HY310-class H713 device.
```

## drivers/display/ge2d/Kconfig
```kconfig
config SUNXI_GE2D
	tristate "Allwinner H713 GE2D display controller"
	depends on OF && ARCH_SUNXI
	select BACKLIGHT_CLASS_DEVICE
	select I2C
	select PWM
	help
	  Phase-1 bring-up driver for the HY310 GE2D display block.

	  Covers: DTS parsing, shared clock/reset ownership, SVP char device
	  (/dev/ge2d), OSD interrupt init, optional backlight and DLPC3435
	  plumbing, and a guarded fbdev scaffold for later hardware validation.

	  fbdev support is conditional on CONFIG_FB at compile time;
	  the module builds and loads cleanly without it.

	  Stock IDA metadata: OF compatible string `trix,ge2d`,
	  platform driver name `ge2d_dev`.
```

## drivers/lradc/Kconfig
```kconfig
config SUN50I_H713_LRADC
	tristate "Allwinner H713 LRADC IIO driver"
	depends on ARCH_SUNXI || COMPILE_TEST
	depends on IIO
	help
	  Say yes here to support the Low-Resolution ADC (LRADC) found in
	  the Allwinner H713 SoC. This driver provides IIO voltage channels
	  for ADC-based keyboard input (via the adc-keys driver) and NTC
	  temperature sensing (via IIO consumer API).

	  This driver replaces direct MMIO access to the LRADC registers,
	  allowing multiple consumers (keyboard + temperature) to share
	  the same hardware safely.

	  To compile this as a module, choose M here: the module will be
	  called sun50i-h713-lradc-iio.
```

## drivers/media/av1/Kconfig
```kconfig
# SPDX-License-Identifier: GPL-2.0-only

config VIDEO_SUN50I_H713_AV1
	tristate "Allwinner H713 AV1 Hardware Decoder"
	depends on ARCH_SUNXI || COMPILE_TEST
	depends on VIDEO_DEV
	select VIDEOBUF2_DMA_CONTIG
	select V4L2_MEM2MEM_DEV
	help
	  Enable support for the Allwinner H713 SoC AV1 hardware decoder.
	  This driver provides V4L2 stateless decoder interface for AV1
	  video streams with hardware acceleration.

	  The H713 is the first Allwinner SoC with dedicated AV1 hardware
	  decoding capability, supporting 10-bit YUV420P AV1 streams up to
	  4K resolution with significant power efficiency improvements over
	  software decoding.

	  To compile this driver as a module, choose M here: the module
	  will be called sun50i-h713-av1.
```
